## boards/shields/thewolfmouse/Kconfig.defconfig
```kconfig
if SHIELD_THEWOLFMOUSE

# 名字需要少於有16個字元
config ZMK_KEYBOARD_NAME
    default "thewolfmouse"

endif
```

## boards/shields/thewolfmouse/Kconfig.shield
```kconfig
# 注意逗號後面不能有空格

config SHIELD_THEWOLFMOUSE
    def_bool $(shields_list_contains,thewolfmouse)
```
